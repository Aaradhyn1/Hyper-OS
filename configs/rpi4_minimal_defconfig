## configs/rpi4_minimal_defconfig
```kconfig
# Hyper-OS: minimal Raspberry Pi 4 Buildroot profile
BR2_aarch64=y
BR2_cortex_a72=y
BR2_TOOLCHAIN_BUILDROOT_MUSL=y
BR2_TOOLCHAIN_BUILDROOT_CXX=n
BR2_OPTIMIZE_S=y
BR2_TARGET_GENERIC_HOSTNAME="hyper-os"
BR2_TARGET_GENERIC_ISSUE="Hyper-OS"
BR2_INIT_BUSYBOX=y
BR2_ROOTFS_OVERLAY="board/raspberrypi4-minimal/rootfs-overlay"

# Linux kernel (upstream long-term)
BR2_LINUX_KERNEL=y
BR2_LINUX_KERNEL_CUSTOM_TARBALL=y
BR2_LINUX_KERNEL_CUSTOM_TARBALL_LOCATION="https://cdn.kernel.org/pub/linux/kernel/v6.x/linux-6.6.30.tar.xz"
BR2_LINUX_KERNEL_DEFCONFIG="bcm2711"
BR2_LINUX_KERNEL_DTS_SUPPORT=y
BR2_LINUX_KERNEL_INTREE_DTS_NAME="broadcom/bcm2711-rpi-4-b"
BR2_LINUX_KERNEL_NEEDS_HOST_OPENSSL=y

# Raspberry Pi firmware and boot files
BR2_PACKAGE_RPI_FIRMWARE=y
BR2_PACKAGE_RPI_FIRMWARE_VARIANT_PI4=y
BR2_PACKAGE_RPI_FIRMWARE_INSTALL_DTB_OVERLAYS=y
BR2_PACKAGE_RPI_FIRMWARE_CONFIG_FILE="board/raspberrypi4-minimal/config.txt"
BR2_PACKAGE_RPI_FIRMWARE_CMDLINE_FILE="board/raspberrypi4-minimal/cmdline.txt"

# BusyBox-only user space
BR2_PACKAGE_BUSYBOX_SHOW_OTHERS=y
BR2_PACKAGE_IFUPDOWN_SCRIPTS=y
BR2_SYSTEM_DHCP="eth0"

# Keep image tiny
BR2_TARGET_ROOTFS_EXT2=y
BR2_TARGET_ROOTFS_EXT2_4=y
BR2_TARGET_ROOTFS_EXT2_SIZE="128M"
BR2_TARGET_ROOTFS_TAR=n
BR2_TARGET_ROOTFS_CPIO=n

# Disable docs/debug artifacts
BR2_ENABLE_DEBUG=n
BR2_STRIP_strip=y
BR2_PACKAGE_HAVE_DEBUG=n

# Optional SSH access for bring-up
BR2_PACKAGE_DROPBEAR=y
```
